#include <Wire.h>
#include <Adafruit_GFX.h>
#include <Adafruit_SSD1306.h>
#include <Adafruit_MPU6050.h>
#include <Adafruit_Sensor.h>

#define OLED_SDA 6
#define OLED_SCL 5

#define MPU_SDA 36
#define MPU_SCL 37

// OLED screen initialization
#define SCREEN_WIDTH 128
#define SCREEN_HEIGHT 64
Adafruit_SSD1306 display(SCREEN_WIDTH, SCREEN_HEIGHT, &Wire, -1);

// MPU6050 initialization
Adafruit_MPU6050 mpu;

// Create a new I2C bus instance (Channel 1)
TwoWire I2C_MPU = TwoWire(1);

const int flexIndex = 1;
const int flexThumb = 2; 
const int flexMiddle = 3;
const int flexRing = 9;
const int flexPinky = 10;

// Helper function: Prints text vertically letter by letter
void printVertical(int x, int y, String text) {
  for (int i = 0; i < text.length(); i++) {
    // Set cursor: X stays fixed, Y increases by 12 pixels per letter
    display.setCursor(x, y + (i * 12)); 
    display.print(text[i]);
  }
}

const unsigned char bitmapAard [] PROGMEM = {
  0x00, 0x00, 0x00, 0x00, 0x00, 0x00, 0x00, 0x00, 0x00, 0x00, 0x00, 0x00, 0x00, 0x00, 0x00, 0x00, 
  0x00, 0x00, 0x00, 0x00, 0x00, 0x00, 0x00, 0x00, 0x00, 0x00, 0x00, 0x00, 0x00, 0x00, 0x00, 0x00, 
  0x00, 0x00, 0x00, 0x00, 0x00, 0x00, 0x00, 0x00, 0x00, 0x00, 0x00, 0x00, 0x00, 0x00, 0x00, 0x00, 
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  0x00, 0x00, 0x00, 0x00, 0x00, 0x00, 0x00, 0x00, 0x00, 0x00, 0x00, 0x00, 0x00, 0x00, 0x00, 0x00
};

void displayAard() {
  display.clearDisplay(); // Clear the display buffer

  // 1. Draw the large sign
  display.drawBitmap(32, 0, bitmapAard, 64, 64, WHITE);

  // 2. Prepare the font
  display.setTextSize(1);
  display.setTextColor(WHITE);
  
  // 3. Print the sign name vertically on the left side
  printVertical(10, 10, "AARD");
  
  // 4. Print the sign name vertically on the right side
  printVertical(112, 10, "AARD");

  // Thin lines separating text from the sign
  display.drawLine(25, 0, 25, 64, WHITE);   // Left border
  display.drawLine(103, 0, 103, 64, WHITE); // Right border
}

const unsigned char bitmapIgni [] PROGMEM = {
  0x00, 0x00, 0x00, 0x00, 0x00, 0x00, 0x00, 0x00, 0x00, 0x00, 0x00, 0x00, 0x00, 0x00, 0x00, 0x00, 
  0x00, 0x00, 0x00, 0x00, 0x00, 0x00, 0x00, 0x00, 0x00, 0x00, 0x00, 0x00, 0x00, 0x00, 0x00, 0x00, 
  0x00, 0x00, 0x00, 0x00, 0x00, 0x00, 0x00, 0x00, 0x00, 0x00, 0x00, 0x00, 0x00, 0x00, 0x00, 0x00, 
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  0x00, 0x00, 0x00, 0x00, 0x00, 0x00, 0x00, 0x00, 0x00, 0x00, 0x00, 0x00, 0x00, 0x00, 0x00, 0x00
};

void displayIgni() {
  display.clearDisplay(); // Clear the display buffer

  // 1. Draw the large sign
  display.drawBitmap(32, 0, bitmapIgni, 64, 64, WHITE);

  // 2. Prepare the font
  display.setTextSize(1);
  display.setTextColor(WHITE);
  
  // 3. Print the sign name vertically on the left side
  printVertical(10, 10, "IGNI");
  
  // 4. Print the sign name vertically on the right side
  printVertical(112, 10, "IGNI");

  // Thin lines separating text from the sign
  display.drawLine(25, 0, 25, 64, WHITE);   // Left border
  display.drawLine(103, 0, 103, 64, WHITE); // Right border
}

const unsigned char bitmapQuen [] PROGMEM = {
	0x00, 0x00, 0x00, 0x00, 0x00, 0x00, 0x00, 0x00, 0x00, 0x00, 0x00, 0x00, 0x00, 0x00, 0x00, 0x00, 
	0x00, 0x00, 0x00, 0x00, 0x00, 0x00, 0x00, 0x00, 0x00, 0x00, 0x00, 0x00, 0x00, 0x00, 0x00, 0x00, 
	0x00, 0x00, 0x00, 0x00, 0x00, 0x00, 0x00, 0x00, 0x00, 0x00, 0x00, 0x00, 0x00, 0x00, 0x00, 0x00, 
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	0x00, 0x00, 0x00, 0x00, 0x00, 0x00, 0x00, 0x00, 0x00, 0x00, 0x00, 0x00, 0x00, 0x00, 0x00, 0x00
};

void displayQuen() {
  display.clearDisplay(); // Clear the display buffer

  // 1. Draw the large sign
  display.drawBitmap(32, 0, bitmapQuen, 64, 64, WHITE);

  // 2. Prepare the font
  display.setTextSize(1);
  display.setTextColor(WHITE);
  
  // 3. Print the sign name vertically on the left side
  printVertical(10, 10, "QUEN");
  
  // 4. Print the sign name vertically on the right side
  printVertical(112, 10, "QUEN");

  // Thin lines separating text from the sign
  display.drawLine(25, 0, 25, 64, WHITE);   // Left border
  display.drawLine(103, 0, 103, 64, WHITE); // Right border
}

const unsigned char bitmapAxii [] PROGMEM = {
	0x00, 0x00, 0x00, 0x00, 0x00, 0x00, 0x00, 0x00, 0x00, 0x00, 0x00, 0x00, 0x00, 0x00, 0x00, 0x00, 
	0x00, 0x00, 0x00, 0x00, 0x00, 0x00, 0x00, 0x00, 0x00, 0x00, 0x00, 0x00, 0x00, 0x00, 0x00, 0x00, 
	0x00, 0x00, 0x00, 0x00, 0x00, 0x00, 0x00, 0x00, 0x00, 0x00, 0x00, 0x00, 0x00, 0x00, 0x00, 0x00, 
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	0x00, 0x00, 0x00, 0x00, 0x00, 0x00, 0x00, 0x00, 0x00, 0x00, 0x00, 0x00, 0x00, 0x00, 0x00, 0x00
};

void displayAxii() {
  display.clearDisplay(); // Clear the display buffer

  // 1. Draw the large sign
  display.drawBitmap(32, 0, bitmapAxii, 64, 64, WHITE);

  // 2. Prepare the font
  display.setTextSize(1);
  display.setTextColor(WHITE);
  
  // 3. Print the sign name vertically on the left side
  printVertical(10, 10, "AXII");
  
  // 4. Print the sign name vertically on the right side
  printVertical(112, 10, "AXII");

  // Thin lines separating text from the sign
  display.drawLine(25, 0, 25, 64, WHITE);   // Left border
  display.drawLine(103, 0, 103, 64, WHITE); // Right border
}

const unsigned char bitmapYrden [] PROGMEM = {
	0x00, 0x00, 0x00, 0x00, 0x00, 0x00, 0x00, 0x00, 0x00, 0x00, 0x00, 0x00, 0x00, 0x00, 0x00, 0x00, 
	0x00, 0x00, 0x00, 0x00, 0x00, 0x00, 0x00, 0x00, 0x00, 0x00, 0x00, 0x00, 0x00, 0x00, 0x00, 0x00, 
	0x00, 0x00, 0x00, 0x00, 0x00, 0x00, 0x00, 0x00, 0x00, 0x00, 0x00, 0x00, 0x00, 0x00, 0x00, 0x00, 
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	0x00, 0x00, 0x00, 0x00, 0x00, 0x00, 0x00, 0x00, 0x00, 0x00, 0x00, 0x00, 0x00, 0x00, 0x00, 0x00
};

void displayYrden() {
  display.clearDisplay(); // Clear the display buffer

  // 1. Draw the large sign
  display.drawBitmap(32, 0, bitmapYrden, 64, 64, WHITE);

  // 2. Prepare the font
  display.setTextSize(1);
  display.setTextColor(WHITE);
  
  // 3. Print the sign name vertically on the left side
  printVertical(10, 5, "YRDEN");
  
  // 4. Print the sign name vertically on the right side
  printVertical(112, 5, "YRDEN");

  // Thin lines separating text from the sign
  display.drawLine(25, 0, 25, 64, WHITE);   // Left border
  display.drawLine(103, 0, 103, 64, WHITE); // Right border
}

void displayZaraza() {
  display.clearDisplay();

  // 1. Set font size to 3 (18x24 pixels per letter)
  display.setTextSize(3);
  display.setTextColor(WHITE);
  
  // 2. Set cursor to calculated center position (X=10, Y=20)
  display.setCursor(10, 20);
  
  // 3. Print Geralt's favorite word
  display.print("ZARAZA");
}

void displayCurse() {
  display.clearDisplay();

  // 1. Set font size to 2 (12x16 pixels per letter)
  display.setTextSize(2);
  display.setTextColor(WHITE);
  
  // 2. Set cursor to calculated center position (X=4, Y=24)
  display.setCursor(4, 24);
  
  // 3. Print curse word
  display.print("SPIERDALAJ");
}

void displayLambert() {
  display.clearDisplay();

  // 1. Set font size to 2 (12x16 pixels per letter)
  display.setTextSize(2);
  display.setTextColor(WHITE);
  
  // 2. Line 1
  display.setCursor(16, 8);
  display.print("LAMBERT,");
  
  // 3. Line 2
  display.setCursor(16, 24); // Y shifted by 16 pixels down
  display.print("LAMBERT,");
  
  // 4. Line 3
  display.setCursor(16, 40); // Y shifted by another 16 pixels
  display.print("TY CHUJU");
}

void displayStorm() {
  display.clearDisplay();

  // 1. Set font size to 2 (12x16 pixels per letter)
  display.setTextSize(2);
  display.setTextColor(WHITE);
  
  // 2. Line 1
  display.setCursor(28, 16);
  display.print("BURZA,");
  
  // 3. Line 2
  display.setCursor(16, 32); // Y shifted by 16 pixels down
  display.print("PSIAKREW");
}

// --- CALIBRATION DATA ---
const int thumbStraight = 2740; const int thumbBent = 2650;
const int indexStraight = 2620; const int indexBent = 2540;
const int middleStraight = 2660; const int middleBent = 2590;
const int ringStraight = 2670; const int ringBent = 2630;
const int pinkyStraight = 1000; const int pinkyBent = 400;

// Universal thresholds in %
const int bentThreshold = 70;      // Finger considered "bent" at 70%
const int straightThreshold = 30;  // Finger considered "straight" at 30%
const int hysteresisMargin = 10;   // 10% tolerance when holding a sign

enum SignType { NONE, QUEN, AARD, IGNI, AXII, YRDEN, ZARAZA, CURSE, LAMBERT, STORM };
SignType activeSign = NONE;

// Smoothed percentage values (EMA filter memory)
float thumbPercentage = 0, indexPercentage = 0, middlePercentage = 0, 
ringPercentage = 0, pinkyPercentage = 0;

void setup() { 
  Serial.begin(9600);
  pinMode(flexThumb, INPUT);
  pinMode(flexIndex, INPUT);
  pinMode(flexMiddle, INPUT);
  pinMode(flexRing, INPUT);
  pinMode(flexPinky, INPUT);

  // Initialize the primary I2C bus for the OLED screen
  Wire.begin(OLED_SDA, OLED_SCL);
  
  // Initialize the secondary I2C bus for the MPU
  I2C_MPU.begin(MPU_SDA, MPU_SCL);

  if(!display.begin(SSD1306_SWITCHCAPVCC, 0x3C)) {
    Serial.println("Error: OLED screen not found!");
  } else {
    Serial.println("OLED Screen - OK");
  }

  // Start the MPU, explicitly telling it to use the secondary bus
  // The default MPU6050 I2C address is 0x68
  if (!mpu.begin(0x68, &I2C_MPU)) {
    Serial.println("Error: MPU6050 not found!");
  } else {
    mpu.setAccelerometerRange(MPU6050_RANGE_8_G);
    mpu.setGyroRange(MPU6050_RANGE_500_DEG);
    mpu.setFilterBandwidth(MPU6050_BAND_21_HZ);
    Serial.println("MPU6050 - OK");
  }
}

void loop() {
  // 1. READ RAW VALUES
  int rawThumb = analogRead(flexThumb);
  int rawIndex = analogRead(flexIndex);
  int rawMiddle = analogRead(flexMiddle);
  int rawRing = analogRead(flexRing);
  int rawPinky = analogRead(flexPinky);

  // Serial.print("Flex thumb sensor: ");
  // Serial.println(rawThumb);
  // Serial.print("Flex index sensor: ");
  // Serial.println(rawIndex);
  // Serial.print("Flex middle sensor: ");
  // Serial.println(rawMiddle);
  // Serial.print("Flex ring sensor: ");
  // Serial.println(rawRing);
  // Serial.print("Flex pinky sensor: ");
  // Serial.println(rawPinky);

  // 2. MAP TO 0-100% AND APPLY EMA FILTER
  // map() handles both increasing and decreasing sensors automatically!
  int targetThumb = constrain(map(rawThumb, thumbStraight, thumbBent, 0, 100), 0, 100);
  int targetIndex = constrain(map(rawIndex, indexStraight, indexBent, 0, 100), 0, 100);
  int targetMiddle = constrain(map(rawMiddle, middleStraight, middleBent, 0, 100), 0, 100);
  int targetRing = constrain(map(rawRing, ringStraight, ringBent, 0, 100), 0, 100);
  int targetPinky = constrain(map(rawPinky, pinkyStraight, pinkyBent, 0, 100), 0, 100);

  // EMA Filtering on percentages (0.1 = smoothness)
  thumbPercentage  = (targetThumb * 0.1)  + (thumbPercentage * 0.9);
  indexPercentage  = (targetIndex * 0.1)  + (indexPercentage * 0.9);
  middlePercentage = (targetMiddle * 0.1) + (middlePercentage * 0.9);
  ringPercentage  = (targetRing * 0.1)   + (ringPercentage * 0.9);
  pinkyPercentage  = (targetPinky * 0.1)  + (pinkyPercentage * 0.9);

  Serial.print("Flex thumb sensor smoothed: ");
  Serial.println(thumbPercentage);
  Serial.print("Flex index sensor smoothed: ");
  Serial.println(indexPercentage);
  Serial.print("Flex middle sensor smoothed: ");
  Serial.println(middlePercentage);
  Serial.print("Flex ring sensor smoothed: ");
  Serial.println(ringPercentage);
  Serial.print("Flex pinky sensor smoothed: ");
  Serial.println(pinkyPercentage);

  // 3. READ MPU DATA
  sensors_event_t a, g, temp;
  mpu.getEvent(&a, &g, &temp);

  Serial.print("Acceleration X: ");
  Serial.print(a.acceleration.x);
  Serial.print(" | Y: ");
  Serial.print(a.acceleration.y);
  Serial.print(" | Z: ");
  Serial.println(a.acceleration.z);

  display.clearDisplay();
  int tolerance = 0; // Current tolerance margin
  SignType detectedThisLoop = NONE;
  
  // QUEN
  tolerance = (activeSign == QUEN) ? hysteresisMargin : 0;
  if (thumbPercentage > (bentThreshold - tolerance) && 
      indexPercentage < (straightThreshold + tolerance) && 
      middlePercentage < (straightThreshold + tolerance) && 
      ringPercentage < (straightThreshold + tolerance) && 
      pinkyPercentage > (bentThreshold - tolerance) &&
      a.acceleration.x > 3 && a.acceleration.z > -5) {
    displayQuen();
    detectedThisLoop = QUEN;
  }

  // AARD
  else {
    tolerance = (activeSign == AARD) ? hysteresisMargin : 0;
    if (thumbPercentage < (straightThreshold + tolerance) && 
        indexPercentage < (straightThreshold + tolerance) && 
        middlePercentage > (bentThreshold - tolerance) && 
        ringPercentage < (straightThreshold + tolerance) && 
        pinkyPercentage < (straightThreshold + tolerance) &&
        a.acceleration.x > 5 && a.acceleration.z > -5) {
      displayAard();
      detectedThisLoop = AARD;
    }

    // IGNI
    else {
      tolerance = (activeSign == IGNI) ? hysteresisMargin : 0;
      if (thumbPercentage < (straightThreshold + tolerance) && 
          indexPercentage > (bentThreshold - tolerance) && 
          middlePercentage < (straightThreshold + tolerance) && 
          ringPercentage < (straightThreshold + tolerance) && 
          pinkyPercentage < (straightThreshold + tolerance + 40) &&
          a.acceleration.x > 5 && a.acceleration.z > -5) {
        displayIgni();
        detectedThisLoop = IGNI;
      }

      // AXII
      else {
        tolerance = (activeSign == AXII) ? hysteresisMargin : 0;
        if (thumbPercentage < (straightThreshold + tolerance) && 
            indexPercentage < (straightThreshold + tolerance) && 
            middlePercentage < (straightThreshold + tolerance) && 
            ringPercentage > (bentThreshold - tolerance) &&
            a.acceleration.x > 3 && a.acceleration.z > -5) {
          displayAxii();
          detectedThisLoop = AXII;
        }

        // YRDEN (Same fingers as Aard, different MPU orientation)
        else {
          tolerance = (activeSign == YRDEN) ? hysteresisMargin : 0;
          if (thumbPercentage < (straightThreshold + tolerance) && 
              indexPercentage < (straightThreshold + tolerance) && 
              middlePercentage > (bentThreshold - tolerance) && 
              ringPercentage < (straightThreshold + tolerance) && 
              pinkyPercentage < (straightThreshold + tolerance) &&
              a.acceleration.x > -3 && a.acceleration.x < 5 && a.acceleration.z > 6) {
            displayYrden();
            detectedThisLoop = YRDEN;
          }

          // ZARAZA
          else {
            tolerance = (activeSign == ZARAZA) ? hysteresisMargin : 0;
            if (thumbPercentage > (bentThreshold - tolerance) && 
                indexPercentage > (bentThreshold - tolerance) && 
                middlePercentage > (bentThreshold - tolerance) && 
                ringPercentage > (bentThreshold - tolerance) && 
                pinkyPercentage > (bentThreshold - tolerance)) {
              displayZaraza();
              detectedThisLoop = ZARAZA;
            }

            // CURSE
            else {
              tolerance = (activeSign == CURSE) ? hysteresisMargin : 0;
              if (indexPercentage > (bentThreshold - tolerance) && 
                  middlePercentage < (straightThreshold + tolerance) && 
                  ringPercentage > (bentThreshold - tolerance) && 
                  pinkyPercentage > (bentThreshold - tolerance)) {
                displayCurse();
                detectedThisLoop = CURSE;
              }

              // LAMBERT
              else {
                tolerance = (activeSign == LAMBERT) ? hysteresisMargin : 0;
                if (thumbPercentage < (straightThreshold + tolerance) && 
                    indexPercentage < (straightThreshold + tolerance) && 
                    middlePercentage > (bentThreshold - tolerance) && 
                    ringPercentage > (bentThreshold - tolerance) && 
                    pinkyPercentage > (bentThreshold - tolerance)) {
                  displayLambert();
                  detectedThisLoop = LAMBERT;
                }

                // STORM
                else {
                  tolerance = (activeSign == STORM) ? hysteresisMargin : 0;
                  if (thumbPercentage < (straightThreshold + tolerance) && 
                      indexPercentage > (bentThreshold - tolerance) && 
                      middlePercentage > (bentThreshold - tolerance) && 
                      ringPercentage > (bentThreshold - tolerance) && 
                      pinkyPercentage > (bentThreshold - tolerance) &&
                      a.acceleration.y > 7) {
                    displayStorm();
                    detectedThisLoop = STORM;
                  }
                }
              }
            }
          }
        }
      }
    }
  }

  activeSign = detectedThisLoop;
  display.display();
  delay(25);
}
